/*
 * Copyright (c) 2021 The ZMK Contributors
 *
 * SPDX-License-Identifier: MIT
 */

&spi0 {
    status = "okay";
    compatible = "nordic,nrf-spim";
    sck-pin = <8>;//D2
    mosi-pin = <6>;//D3
    cs-gpios = <&pro_micro 2 GPIO_ACTIVE_HIGH>;//D1
    // Unused pin, needed for SPI definition, but not used by the display driver itself.
    miso-pin = <22>; // 0.22 is not broken out on the nRFMicro

	ls0xx@0 {
		compatible = "sharp,ls0xx";
		label = "DISPLAY";
		spi-max-frequency = <2000000>;
		reg = <0>;
		width = <160>;
		height = <68>;
		extcomin-gpios = <&pro_micro 3 GPIO_ACTIVE_HIGH>;//D0
		extcomin-frequency = <60>;
		disp-en-gpios = <&pro_micro 20 GPIO_ACTIVE_HIGH>; //F5
	};
};
