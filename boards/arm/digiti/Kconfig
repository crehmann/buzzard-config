## boards/arm/digiti/Kconfig
```kconfig
# Copyright (c) 2021 The ZMK Contributors
# SPDX-License-Identifier: MIT

config BOARD_ENABLE_DCDC
	bool "Enable DCDC mode"
	select SOC_DCDC_NRF52X
	default y
	depends on (BOARD_DIGITI_LEFT || BOARD_DIGITI_RIGHT)


if CUSTOM_WIDGET_BONGO_CAT

config CUSTOM_WIDGET_BONGO_CAT_IDLE_LIMIT
    int "Upper limit for WPM for showing idle animation"
    default 30

config CUSTOM_WIDGET_BONGO_CAT_SLOW_LIMIT
    int "Upper limit for WPM for showing slow typing image"
    default 60

endif # BONGO_CAT
```

## boards/arm/digiti/Kconfig.board
```kconfig
# Copyright (c) 2021 The ZMK Contributors
# SPDX-License-Identifier: MIT

config BOARD_DIGITI_LEFT
	bool "digiti_left"
	depends on SOC_NRF52840_QIAA

config BOARD_DIGITI_RIGHT
	bool "digiti_right"
	depends on SOC_NRF52840_QIAA
```

## boards/arm/digiti/Kconfig.defconfig
```kconfig
# Copyright (c) 2021 The ZMK Contributors
# SPDX-License-Identifier: MIT

if BOARD_DIGITI_LEFT

config ZMK_KEYBOARD_NAME
	default "Digiti"

config ZMK_SPLIT_ROLE_CENTRAL
	default y

endif # BOARD_DIGITI_LEFT

if BOARD_DIGITI_RIGHT

	config ZMK_KEYBOARD_NAME
	default "Digiti Right"

endif # BOARD_DIGITI_RIGHT


if BOARD_DIGITI_LEFT || BOARD_DIGITI_RIGHT

config BOARD
	default "digiti"

config ZMK_SPLIT
	default y

config BT_CTLR
	default BT

config ZMK_BLE
	default y

config ZMK_USB
	default y

config ZMK_BATTERY_VOLTAGE_DIVIDER
	default y

config ZMK_DISPLAY
	select LV_USE_CONT
	select LV_FONT_MONTSERRAT_26
    select LV_USE_IMG
	select LV_USE_LABEL


if ZMK_DISPLAY

config SPI
	default y

config LS0XX
	default y

config LV_Z_BITS_PER_PIXEL
	default 1

choice LV_COLOR_DEPTH
	default LV_COLOR_DEPTH_1

endchoice

endif # ZMK_DISPLAY

if USB
config USB_NRFX
	default y
config USB_DEVICE_STACK
	default y
endif # USB

menuconfig CUSTOM_WIDGET_BATTERY_STATUS
	bool "custom battery status widget"

menuconfig CUSTOM_WIDGET_LAYER_STATUS
	bool "custom layer status widget"
	
menuconfig CUSTOM_WIDGET_OUTPUT_STATUS
	bool "custom output status widget"

menuconfig CUSTOM_WIDGET_PERIPHERAL_STATUS
	bool "custom perihperal status widget"

endif # BOARD_DIGITI_LEFT || BOARD_DIGITI_RIGHT
```

## boards/arm/scylla/Kconfig
```kconfig
# Copyright (c) 2021 The ZMK Contributors
# SPDX-License-Identifier: MIT

config BOARD_ENABLE_DCDC
	bool "Enable DCDC mode"
	select SOC_DCDC_NRF52X
	default y
	depends on (BOARD_SCYLLA_LEFT || BOARD_SCYLLA_RIGHT)

config BOARD_SCYLLA_CHARGER
	bool "Enable battery charger"
	default y
	depends on (BOARD_SCYLLA_LEFT || BOARD_SCYLLA_RIGHT)
```

## boards/arm/scylla/Kconfig.board
```kconfig
# Copyright (c) 2021 The ZMK Contributors
# SPDX-License-Identifier: MIT

config BOARD_SCYLLA_LEFT
	bool "scylla_left"
	depends on SOC_NRF52840_QIAA

config BOARD_SCYLLA_RIGHT
	bool "scylla_right"
	depends on SOC_NRF52840_QIAA
```

## boards/arm/tps42/Kconfig.board
```kconfig
# Copyright (c) 2021 The ZMK Contributors
# SPDX-License-Identifier: MIT

config BOARD_TPS42_LEFT
	bool "tps42_left"
	depends on SOC_NRF52840_QIAA

config BOARD_TPS42_RIGHT
	bool "tps42_right"
	depends on SOC_NRF52840_QIAA
```

## boards/arm/tps42/Kconfig.defconfig
```kconfig
# Copyright (c) 2021 The ZMK Contributors
# SPDX-License-Identifier: MIT

if BOARD_TPS42_LEFT

	config ZMK_KEYBOARD_NAME
	default "TPS42"

    config ZMK_SPLIT_BLE_ROLE_CENTRAL
	default y

endif # BOARD_TPS42_LEFT

if BOARD_TPS42_RIGHT

	config ZMK_KEYBOARD_NAME
	default "TPS42 Right"

endif # BOARD_TPS42_RIGHT


if BOARD_TPS42_LEFT || BOARD_TPS42_RIGHT

config BOARD
	default "tps42"

config ZMK_SPLIT
	default y

config BT_CTLR
	default BT

config ZMK_BLE
	default y

config ZMK_USB
	default y

config PINMUX
	default y

config BOARD_TPS42_CHARGER
	default y

config ZMK_BATTERY_VOLTAGE_DIVIDER
	default y

config ZMK_DISPLAY
	select LVGL_USE_CONT
	select LVGL_FONT_MONTSERRAT_26
    select LVGL_USE_IMG
	select LVGL_USE_ANIMATION
	select LVGL_USE_LABEL


if ZMK_DISPLAY
choice LVGL_THEME_DEFAULT_FONT_SMALL
    default LVGL_THEME_DEFAULT_FONT_SMALL_MONTSERRAT_36

endchoice
config LVGL_HOR_RES_MAX
	default 160

config LVGL_VER_RES_MAX
	default 68

config SPI
	default y

config LS0XX
	default y

config LVGL_BITS_PER_PIXEL
	default 1

choice LVGL_COLOR_DEPTH
	default LVGL_COLOR_DEPTH_1

endchoice
config LVGL_DPI
	default 30

config LVGL_VDB_SIZE
	default 4
endif # ZMK_DISPLAY

if USB
config USB_NRFX
	default y
config USB_DEVICE_STACK
	default y
endif # USB

menuconfig CUSTOM_WIDGET_BATTERY_STATUS
	bool "custom battery status widget"

menuconfig CUSTOM_WIDGET_LAYER_STATUS
	bool "custom layer status widget"
	
menuconfig CUSTOM_WIDGET_OUTPUT_STATUS
	bool "custom output status widget"

endif # BOARD_TPS42_LEFT || BOARD_TPS42_RIGHT
```

## boards/arm/tps42/tps42_right_defconfig
```kconfig
# SPDX-License-Identifier: MIT

CONFIG_BUILD_OUTPUT_UF2=y

CONFIG_ZMK_SPLIT_ROLE_CENTRAL=n

CONFIG_SOC_SERIES_NRF52X=y
CONFIG_SOC_NRF52840_QIAA=y
CONFIG_BOARD_TPS42_RIGHT=y
CONFIG_ZMK_SPLIT=y
CONFIG_ZMK_SLEEP=y

# Enable MPU
CONFIG_ARM_MPU=y

# enable GPIO
CONFIG_GPIO=y
CONFIG_PINCTRL=y

# Enable writing to flash
CONFIG_USE_DT_CODE_PARTITION=y
CONFIG_MPU_ALLOW_FLASH_WRITE=y
CONFIG_NVS=y
CONFIG_SETTINGS_NVS=y
CONFIG_FLASH=y
CONFIG_FLASH_PAGE_LAYOUT=y
CONFIG_FLASH_MAP=y
CONFIG_CLOCK_CONTROL_NRF=y
CONFIG_CLOCK_CONTROL_NRF_K32SRC_RC=y

# Enable display
CONFIG_ZMK_DISPLAY=y
CONFIG_ZMK_LV_FONT_DEFAULT_SMALL_MONTSERRAT_26=y
CONFIG_LV_FONT_DEFAULT_MONTSERRAT_26=y
#CONFIG_ZMK_DISPLAY_BLANK_ON_IDLE=n

# custom status screens
CONFIG_ZMK_DISPLAY_STATUS_SCREEN_CUSTOM=y
CONFIG_ZMK_DISPLAY_STATUS_SCREEN_BUILT_IN=n

CONFIG_CUSTOM_WIDGET_BATTERY_STATUS=y
CONFIG_ZMK_WIDGET_BATTERY_STATUS=n

CONFIG_CUSTOM_WIDGET_LAYER_STATUS=n
CONFIG_ZMK_WIDGET_LAYER_STATUS=n

CONFIG_CUSTOM_WIDGET_OUTPUT_STATUS=n
CONFIG_ZMK_WIDGET_OUTPUT_STATUS=n

CONFIG_CUSTOM_WIDGET_PERIPHERAL_STATUS=y
CONFIG_ZMK_WIDGET_PERIPHERAL_STATUS=n

# Turn on logging, and set ZMK logging to debug output
# CONFIG_ZMK_USB_LOGGING=y

# Turn on logging, and set ZMK logging to debug output
# CONFIG_LOG=y
# CONFIG_ZMK_LOG_LEVEL_DBG=y
```

## boards/shields/buzzard/Kconfig.defconfig
```kconfig
# Copyright (c) 2021 The ZMK Contributors
# SPDX-License-Identifier: MIT

if SHIELD_BUZZARD_LEFT

config ZMK_KEYBOARD_NAME
    default "Buzzard"

config ZMK_SPLIT_ROLE_CENTRAL
    default y

endif

if SHIELD_BUZZARD_LEFT || SHIELD_BUZZARD_RIGHT

config ZMK_SPLIT
    default y

config ZMK_DISPLAY
	select LV_USE_CONT
	select LV_FONT_MONTSERRAT_26
	

choice ZMK_DISPLAY_STATUS_SCREEN
	default ZMK_DISPLAY_STATUS_SCREEN_BUILT_IN

endchoice


if ZMK_DISPLAY

config SPI
	default y

config LS0XX
	default y

config LV_Z_BITS_PER_PIXEL
	default 1

choice LV_COLOR_DEPTH
	default LV_COLOR_DEPTH_1

endchoice

endif # ZMK_DISPLAY

endif # SHIELD_BUZZARD_LEFT || SHIELD_BUZZARD_RIGHT
```

## boards/shields/buzzard/Kconfig.shield
```kconfig
# Copyright (c) 2021 The ZMK Contributors
# SPDX-License-Identifier: MIT

config SHIELD_BUZZARD_LEFT
    def_bool $(shields_list_contains,buzzard_left)

config SHIELD_BUZZARD_RIGHT
    def_bool $(shields_list_contains,buzzard_right)
```

## boards/shields/nrftester/Kconfig.defconfig
```kconfig
# Copyright (c) 2021 The ZMK Contributors
# SPDX-License-Identifier: MIT

if SHIELD_NRFTESTER

config ZMK_KEYBOARD_NAME
	default "NRF-Tester"

config ZMK_SPLIT_ROLE_CENTRAL
	default y

endif
```

## boards/shields/scylla/Kconfig.shield
```kconfig
# Copyright (c) 2021 The ZMK Contributors
# SPDX-License-Identifier: MIT

config SHIELD_SCYLLA_LEFT
    def_bool $(shields_list_contains,scylla_left)

config SHIELD_SCYLLA_RIGHT
    def_bool $(shields_list_contains,scylla_right)
```

## boards/shields/tps40/Kconfig.defconfig
```kconfig
# Copyright (c) 2021 The ZMK Contributors
# SPDX-License-Identifier: MIT

if SHIELD_TPS40_LEFT

config ZMK_KEYBOARD_NAME
    default "TPS40"

config ZMK_SPLIT_ROLE_CENTRAL
    default y

endif

if SHIELD_TPS40_LEFT || SHIELD_TPS40_RIGHT

config ZMK_SPLIT
    default y

config ZMK_DISPLAY
	select LV_USE_CONT
	select LV_FONT_MONTSERRAT_26
	

choice ZMK_DISPLAY_STATUS_SCREEN
	default ZMK_DISPLAY_STATUS_SCREEN_BUILT_IN

endchoice


if ZMK_DISPLAY

config SPI
	default y

config LS0XX
	default y

config LV_Z_BITS_PER_PIXEL
	default 1

choice LV_COLOR_DEPTH
	default LV_COLOR_DEPTH_1

endchoice

endif # ZMK_DISPLAY

endif # SHIELD_TPS40_LEFT || SHIELD_TPS40_RIGHT
```

## boards/shields/tps40/Kconfig.shield
```kconfig
# Copyright (c) 2021 The ZMK Contributors
# SPDX-License-Identifier: MIT

config SHIELD_TPS40_LEFT
    def_bool $(shields_list_contains,tps40_left)

config SHIELD_TPS40_RIGHT
    def_bool $(shields_list_contains,tps40_right)
```

## west.yml
```yaml
manifest:
  remotes:
    - name: zmkfirmware
      url-base: https://github.com/zmkfirmware
    - name: crehmann
      url-base: https://github.com/crehmann
  projects:
    - name: zmk
      remote: zmkfirmware
      revision: main
      import: app/west.yml
  self:
    path: config
```
